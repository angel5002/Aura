## firmware/versiones/0.1.3/main/Kconfig.projbuild
```kconfig
menu "Wi-Fi sensing demo"

choice ESP_WIFI_SENSING_DEMO_LED_TYPE
    prompt "LED type"
    default ESP_WIFI_SENSING_DEMO_LED_TYPE_GPIO
    help
        Choose between a single GPIO LED and a single WS2812 LED.

    config ESP_WIFI_SENSING_DEMO_LED_TYPE_GPIO
        bool "GPIO LED"

    config ESP_WIFI_SENSING_DEMO_LED_TYPE_WS2812
        bool "WS2812 LED"
endchoice

config ESP_WIFI_SENSING_DEMO_LED_GPIO
    int "LED GPIO"
    default 2
    help
        GPIO used for the LED output. For WS2812 this is the data pin.

if ESP_WIFI_SENSING_DEMO_LED_TYPE_WS2812

choice ESP_WIFI_SENSING_DEMO_WS2812_BACKEND
    prompt "WS2812 backend"
    default ESP_WIFI_SENSING_DEMO_WS2812_BACKEND_RMT
    help
        Select the peripheral used to drive the WS2812 LED.

    config ESP_WIFI_SENSING_DEMO_WS2812_BACKEND_RMT
        bool "RMT backend"

    config ESP_WIFI_SENSING_DEMO_WS2812_BACKEND_SPI
        bool "SPI backend"
endchoice

endif

config ESP_WIFI_SENSING_WEB_SERIAL_ENABLE
    bool "Enable Web Serial monitor output"
    default y
    help
        Stream sensing diagnostics to the host over the standard serial console.
        The browser Web Serial page can connect to whichever serial port is
        exposed by the current console configuration.

config ESP_WIFI_SENSING_WEB_SERIAL_STREAM_PERIOD_MS
    int "Web Serial stream period (ms)"
    default 50
    range 20 1000
    depends on ESP_WIFI_SENSING_WEB_SERIAL_ENABLE
    help
        Period used to push one diagnostic snapshot per channel to the Web Serial UI.

endmenu

menu "AURA nodo"
    comment "Sin secretos aqui: las credenciales van en NVS (cargar_credenciales.py)."

    config AURA_SENSOR_ID
        string "Identificador del sensor en Firebase"
        default "hab1"

    config AURA_UDP_PUERTO
        int "Puerto UDP de datos y comandos locales"
        default 45454

    config AURA_ANUNCIO_PUERTO
        int "Puerto UDP de anuncios (broadcast)"
        default 45455

    config AURA_OTA_PUERTO
        int "Puerto TCP de OTA local"
        default 45456

    config AURA_LOCAL_MAX_SUSCRIPTORES
        int "Receptores locales simultaneos"
        default 3
        range 1 6

    config AURA_LOCAL_COLA_KB
        int "Cola de la via local (KB)"
        default 16
        range 4 32
        help
            Buffer circular entre los productores (CSI, HMS) y la tarea UDP. 16 KB ~ 0,5 s de datos a
            velocidad completa. Bajarlo libera RAM a costa de descartar datos si la red se atasca.

    config AURA_NUBE_BUFFER_KB
        int "Buffers de cuerpo y respuesta de la nube (KB cada uno)"
        default 4
        range 2 8

    config AURA_NUBE_CONSULTA_S
        int "Intervalo de consulta de comandos en la nube (s)"
        default 5
        range 2 60

    config AURA_NUBE_LATIDO_S
        int "Intervalo del latido en la nube (s)"
        default 60

    config AURA_NUBE_BLOQUE_S
        int "Duracion de cada bloque /crudo (s)"
        default 10
        range 5 120

    config AURA_RETENCION_MOV_S
        int "Retencion del estado MOVIMIENTO tras el ultimo ACTIVE (s)"
        default 10

    config AURA_QUIETUD_MIN
        int "Minutos de presencia sin movimiento para la alerta de quietud"
        default 2

    config AURA_REINTENTO_PRINCIPAL_MIN
        int "En la red de respaldo, buscar la red principal cada N minutos"
        default 15
        range 1 120
        help
            Estando en el respaldo (hotspot), la placa escanea sin desconectarse buscando la red
            principal; si la encuentra, vuelve a ella. Al cambiar de red el detector se recrea y la
            presencia queda "no_disponible" hasta reentrenar.

    config AURA_DIAG_UMBRAL_KB
        int "Diagnostico: memoria libre (KB) por debajo de la cual se sigue y se informa un episodio"
        default 30

    config AURA_AUTOPRUEBA_VENTANA_S
        int "Autoprueba OTA: segundos seguidos que deben cumplirse todas las condiciones"
        default 10
        range 5 120
        help
            Una imagen nueva (OTA) solo se marca como valida si durante este tiempo seguido hay IP,
            el detector existe y recibe CSI, todas las tareas propias existen y la memoria libre no
            baja de AURA_AUTOPRUEBA_HEAP_MIN_KB. Si algo falla, la ventana vuelve a empezar.

    config AURA_AUTOPRUEBA_HEAP_MIN_KB
        int "Autoprueba OTA: memoria libre minima (KB) en cada muestra de la ventana"
        default 16

    config AURA_AUTOPRUEBA_MAX_S
        int "Autoprueba OTA: reiniciar (vuelve a la imagen anterior) si no se valida en este tiempo (s); 0 = nunca"
        default 600
        range 0 3600

    config AURA_PRUEBA_ROLLBACK
        bool "PRUEBA D8(d): no marcar la imagen como valida y reiniciar a los 30 s"
        default n
        help
            Solo para la prueba de vuelta atras. Una imagen compilada con esta opcion nunca
            se marca como valida; tras una OTA el cargador debe volver a la version anterior.
endmenu
```
